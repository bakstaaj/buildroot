## package/ft8-lib/Config.in
```kconfig
config BR2_PACKAGE_FT8_LIB
	bool "ft8-lib"
	help
	  Lightweight C FT8/FT4 encoder and decoder library designed for
	  resource-constrained systems. This package installs a static library
	  and headers for firmware applications; it does not install the
	  upstream desktop demo programs.

	  https://github.com/kgoba/ft8_lib
```

## package/pluto-audio-dsp/Config.in
```kconfig
config BR2_PACKAGE_PLUTO_AUDIO_DSP
	bool "pluto-audio-dsp"
	depends on BR2_TOOLCHAIN_USES_GLIBC || BR2_TOOLCHAIN_USES_MUSL
	depends on !BR2_STATIC_LIBS
	select BR2_PACKAGE_LIBIIO
	select BR2_PACKAGE_LIQUID_DSP
	select BR2_PACKAGE_FT8_LIB
	help
	  Pluto firmware audio and spectrum DSP backends.

	  This builds a small C /usr/sbin/pluto-audio-backend executable
	  around libiio and liquid-dsp so applications can request decoded
	  PCM audio through the reusable Pluto radio API. The backend also
	  provides rolling CW and slot-based FT8 decode status. It installs
	  /usr/sbin/pluto-spectrum-backend for firmware API spectrum snapshots.

comment "pluto-audio-dsp requires a glibc or musl toolchain w/ dynamic library"
	depends on !(BR2_TOOLCHAIN_USES_GLIBC || BR2_TOOLCHAIN_USES_MUSL) || BR2_STATIC_LIBS
```

## package/python-sgp4/Config.in
```kconfig
config BR2_PACKAGE_PYTHON_SGP4
	bool "python-sgp4"
	help
	  Track Earth satellite positions from TLE orbital elements using
	  the SGP4/SDP4 propagation algorithms.

	  https://github.com/brandon-rhodes/python-sgp4
```
